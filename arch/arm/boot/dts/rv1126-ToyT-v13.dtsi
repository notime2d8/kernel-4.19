// SPDX-License-Identifier: (GPL-2.0+ OR MIT)
/*
 * Copyright (c) 2020 Rockchip Electronics Co., Ltd.
 */

#include "rv1126-ToyT-v12.dtsi"

&backlight {
	pwms = <&pwm2 0 25000 0>;
};

&pwm0 {
	status = "okay";
};

&pwm2 {
	status = "okay";
};

&u2phy0 {
	vup-gpios = <&gpio0 RK_PC1 GPIO_ACTIVE_LOW>;
};
